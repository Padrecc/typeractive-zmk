## config/west.yml
```yaml
manifest:
    remotes:
        - name: zmkfirmware
          url-base: https://github.com/zmkfirmware   
        - name: padrecc
          url-base: https://github.com/padrecc
    projects:
        - name: zmk
          remote: zmkfirmware
          revision: v0.3
          import: app/west.yml
        - name: zmk-nice-oled
          remote: padrecc
          revision: main 
    self:
        path: config
```
